## tests/iqs9151_work_cb/testcase.yaml
```yaml
common:
  tags:
    - iqs9151
    - input
  platform_allow:
    - qemu_cortex_m3
    - native_sim
    - native_sim_64
tests:
  iqs9151.work_cb: {}
  iqs9151.transport:
    extra_args: YUPAD43_TEST_TRANSPORT=ON
  iqs9151.work_cb.custom_config:
    extra_args: YUPAD43_TEST_CUSTOM_CONFIG=ON
  iqs9151.work_cb.horizontal_swipe:
    extra_args: YUPAD43_TEST_HORIZONTAL_SWIPE=ON
  iqs9151.work_cb.horizontal_swipe_no_tapdrag:
    extra_args:
      - YUPAD43_TEST_HORIZONTAL_SWIPE=ON
      - YUPAD43_TEST_NO_TAPDRAG=ON
```
